## build/settings_reset/Kconfig/Kconfig.shield.defconfig
```kconfig
osource "/home/tverdyy/Projects/uroblike-zyraft/config/boards/shields/*/Kconfig.defconfig"
osource "/home/tverdyy/Projects/uroblike-zyraft/zmk/app/module/boards/shields/*/Kconfig.defconfig"
osource "/home/tverdyy/Projects/uroblike-zyraft/prospector-zmk-module/boards/shields/*/Kconfig.defconfig"
osource "/home/tverdyy/Projects/uroblike-zyraft/zmk/app/boards/shields/*/Kconfig.defconfig"
osource "/home/tverdyy/Projects/uroblike-zyraft/config/boards/shields/*/Kconfig.defconfig"
```

## build/settings_reset/Kconfig/boards/Kconfig
```kconfig
# Load Zephyr board Kconfig descriptions.
osource "/home/tverdyy/Projects/uroblike-zyraft/zmk/app/module/boards/nicekeyboards/nice_nano/Kconfig"
osource "/home/tverdyy/Projects/uroblike-zyraft/zmk/app/boards/nicekeyboards/nice_nano/Kconfig"
```

## build/settings_reset/Kconfig/boards/Kconfig.defconfig
```kconfig
# Load Zephyr board defconfig descriptions.
osource "/home/tverdyy/Projects/uroblike-zyraft/zmk/app/module/boards/nicekeyboards/nice_nano/Kconfig.defconfig"
osource "/home/tverdyy/Projects/uroblike-zyraft/zmk/app/boards/nicekeyboards/nice_nano/Kconfig.defconfig"
```

## build/settings_reset/Kconfig/soc/Kconfig
```kconfig
# Load Zephyr SoC Kconfig descriptions.
osource "/home/tverdyy/Projects/uroblike-zyraft/zephyr/soc/xlnx/zynqmp/Kconfig"
osource "/home/tverdyy/Projects/uroblike-zyraft/zephyr/soc/xlnx/zynq7000/Kconfig"
osource "/home/tverdyy/Projects/uroblike-zyraft/zephyr/soc/xen/Kconfig"
osource "/home/tverdyy/Projects/uroblike-zyraft/zephyr/soc/wch/ch32v/Kconfig"
osource "/home/tverdyy/Projects/uroblike-zyraft/zephyr/soc/ti/simplelink/Kconfig"
osource "/home/tverdyy/Projects/uroblike-zyraft/zephyr/soc/ti/lm3s6965/Kconfig"
osource "/home/tverdyy/Projects/uroblike-zyraft/zephyr/soc/ti/k3/Kconfig"
osource "/home/tverdyy/Projects/uroblike-zyraft/zephyr/soc/telink/tlsr/Kconfig"
osource "/home/tverdyy/Projects/uroblike-zyraft/zephyr/soc/starfive/jh71xx/Kconfig"
osource "/home/tverdyy/Projects/uroblike-zyraft/zephyr/soc/st/stm32/Kconfig"
osource "/home/tverdyy/Projects/uroblike-zyraft/zephyr/soc/snps/qemu_arc/Kconfig"
osource "/home/tverdyy/Projects/uroblike-zyraft/zephyr/soc/snps/nsim/arc_v/Kconfig"
osource "/home/tverdyy/Projects/uroblike-zyraft/zephyr/soc/snps/nsim/arc_classic/Kconfig"
osource "/home/tverdyy/Projects/uroblike-zyraft/zephyr/soc/snps/hsdk4xd/Kconfig"
osource "/home/tverdyy/Projects/uroblike-zyraft/zephyr/soc/snps/hsdk/Kconfig"
osource "/home/tverdyy/Projects/uroblike-zyraft/zephyr/soc/snps/emsk/Kconfig"
osource "/home/tverdyy/Projects/uroblike-zyraft/zephyr/soc/snps/emsdp/Kconfig"
osource "/home/tverdyy/Projects/uroblike-zyraft/zephyr/soc/snps/arc_iot/Kconfig"
osource "/home/tverdyy/Projects/uroblike-zyraft/zephyr/soc/silabs/Kconfig"
osource "/home/tverdyy/Projects/uroblike-zyraft/zephyr/soc/sifive/sifive_freedom/Kconfig"
osource "/home/tverdyy/Projects/uroblike-zyraft/zephyr/soc/sensry/Kconfig"
osource "/home/tverdyy/Projects/uroblike-zyraft/zephyr/soc/rockchip/Kconfig"
osource "/home/tverdyy/Projects/uroblike-zyraft/zephyr/soc/renode/riscv_virtual/Kconfig"
osource "/home/tverdyy/Projects/uroblike-zyraft/zephyr/soc/renode/cortex_r8_virtual/Kconfig"
osource "/home/tverdyy/Projects/uroblike-zyraft/zephyr/soc/renesas/smartbond/Kconfig"
osource "/home/tverdyy/Projects/uroblike-zyraft/zephyr/soc/renesas/rzt2m/Kconfig"
osource "/home/tverdyy/Projects/uroblike-zyraft/zephyr/soc/renesas/rz/Kconfig"
osource "/home/tverdyy/Projects/uroblike-zyraft/zephyr/soc/renesas/rcar/Kconfig"
osource "/home/tverdyy/Projects/uroblike-zyraft/zephyr/soc/renesas/ra/Kconfig"
osource "/home/tverdyy/Projects/uroblike-zyraft/zephyr/soc/realtek/ec/Kconfig"
osource "/home/tverdyy/Projects/uroblike-zyraft/zephyr/soc/raspberrypi/rpi_pico/Kconfig"
osource "/home/tverdyy/Projects/uroblike-zyraft/zephyr/soc/quicklogic/eos_s3/Kconfig"
osource "/home/tverdyy/Projects/uroblike-zyraft/zephyr/soc/qemu/virt_riscv/Kconfig"
osource "/home/tverdyy/Projects/uroblike-zyraft/zephyr/soc/qemu/malta/Kconfig"
osource "/home/tverdyy/Projects/uroblike-zyraft/zephyr/soc/openisa/rv32m1/Kconfig"
osource "/home/tverdyy/Projects/uroblike-zyraft/zephyr/soc/nxp/s32/Kconfig"
osource "/home/tverdyy/Projects/uroblike-zyraft/zephyr/soc/nxp/rw/Kconfig"
osource "/home/tverdyy/Projects/uroblike-zyraft/zephyr/soc/nxp/mcx/Kconfig"
osource "/home/tverdyy/Projects/uroblike-zyraft/zephyr/soc/nxp/lpc/Kconfig"
osource "/home/tverdyy/Projects/uroblike-zyraft/zephyr/soc/nxp/layerscape/Kconfig"
osource "/home/tverdyy/Projects/uroblike-zyraft/zephyr/soc/nxp/kinetis/Kconfig"
osource "/home/tverdyy/Projects/uroblike-zyraft/zephyr/soc/nxp/imxrt/Kconfig"
osource "/home/tverdyy/Projects/uroblike-zyraft/zephyr/soc/nxp/imx/Kconfig"
osource "/home/tverdyy/Projects/uroblike-zyraft/zephyr/soc/nuvoton/numicro/Kconfig"
osource "/home/tverdyy/Projects/uroblike-zyraft/zephyr/soc/nuvoton/numaker/Kconfig"
osource "/home/tverdyy/Projects/uroblike-zyraft/zephyr/soc/nuvoton/npcx/Kconfig"
osource "/home/tverdyy/Projects/uroblike-zyraft/zephyr/soc/nuvoton/npcm/Kconfig"
osource "/home/tverdyy/Projects/uroblike-zyraft/zephyr/soc/nordic/Kconfig"
osource "/home/tverdyy/Projects/uroblike-zyraft/zephyr/soc/neorv32/Kconfig"
osource "/home/tverdyy/Projects/uroblike-zyraft/zephyr/soc/native/inf_clock/Kconfig"
osource "/home/tverdyy/Projects/uroblike-zyraft/zephyr/soc/microchip/miv/Kconfig"
osource "/home/tverdyy/Projects/uroblike-zyraft/zephyr/soc/microchip/mec/Kconfig"
osource "/home/tverdyy/Projects/uroblike-zyraft/zephyr/soc/mediatek/mt8xxx/Kconfig"
osource "/home/tverdyy/Projects/uroblike-zyraft/zephyr/soc/lowrisc/opentitan/Kconfig"
osource "/home/tverdyy/Projects/uroblike-zyraft/zephyr/soc/litex/litex_vexriscv/Kconfig"
osource "/home/tverdyy/Projects/uroblike-zyraft/zephyr/soc/ite/ec/Kconfig"
osource "/home/tverdyy/Projects/uroblike-zyraft/zephyr/soc/intel/raptor_lake/Kconfig"
osource "/home/tverdyy/Projects/uroblike-zyraft/zephyr/soc/intel/lakemont/Kconfig"
osource "/home/tverdyy/Projects/uroblike-zyraft/zephyr/soc/intel/intel_socfpga_std/Kconfig"
osource "/home/tverdyy/Projects/uroblike-zyraft/zephyr/soc/intel/intel_socfpga/Kconfig"
osource "/home/tverdyy/Projects/uroblike-zyraft/zephyr/soc/intel/intel_niosv/Kconfig"
osource "/home/tverdyy/Projects/uroblike-zyraft/zephyr/soc/intel/intel_ish/Kconfig"
osource "/home/tverdyy/Projects/uroblike-zyraft/zephyr/soc/intel/intel_adsp/Kconfig"
osource "/home/tverdyy/Projects/uroblike-zyraft/zephyr/soc/intel/elkhart_lake/Kconfig"
osource "/home/tverdyy/Projects/uroblike-zyraft/zephyr/soc/intel/atom/Kconfig"
osource "/home/tverdyy/Projects/uroblike-zyraft/zephyr/soc/intel/apollo_lake/Kconfig"
osource "/home/tverdyy/Projects/uroblike-zyraft/zephyr/soc/intel/alder_lake/Kconfig"
osource "/home/tverdyy/Projects/uroblike-zyraft/zephyr/soc/infineon/cat3/Kconfig"
osource "/home/tverdyy/Projects/uroblike-zyraft/zephyr/soc/infineon/cat1b/Kconfig"
osource "/home/tverdyy/Projects/uroblike-zyraft/zephyr/soc/infineon/cat1a/Kconfig"
osource "/home/tverdyy/Projects/uroblike-zyraft/zephyr/soc/gd/gd32/Kconfig"
osource "/home/tverdyy/Projects/uroblike-zyraft/zephyr/soc/gaisler/leon3/Kconfig"
osource "/home/tverdyy/Projects/uroblike-zyraft/zephyr/soc/gaisler/gr716a/Kconfig"
osource "/home/tverdyy/Projects/uroblike-zyraft/zephyr/soc/espressif/Kconfig"
osource "/home/tverdyy/Projects/uroblike-zyraft/zephyr/soc/ene/kb1200/Kconfig"
osource "/home/tverdyy/Projects/uroblike-zyraft/zephyr/soc/efinix/sapphire/Kconfig"
osource "/home/tverdyy/Projects/uroblike-zyraft/zephyr/soc/cdns/xtensa_sample_controller/Kconfig"
osource "/home/tverdyy/Projects/uroblike-zyraft/zephyr/soc/cdns/sample_controller32/Kconfig"
osource "/home/tverdyy/Projects/uroblike-zyraft/zephyr/soc/cdns/dc233c/Kconfig"
osource "/home/tverdyy/Projects/uroblike-zyraft/zephyr/soc/brcm/bcmvk/Kconfig"
osource "/home/tverdyy/Projects/uroblike-zyraft/zephyr/soc/brcm/bcm2712/Kconfig"
osource "/home/tverdyy/Projects/uroblike-zyraft/zephyr/soc/brcm/bcm2711/Kconfig"
osource "/home/tverdyy/Projects/uroblike-zyraft/zephyr/soc/atmel/sam0/Kconfig"
osource "/home/tverdyy/Projects/uroblike-zyraft/zephyr/soc/atmel/sam/Kconfig"
osource "/home/tverdyy/Projects/uroblike-zyraft/zephyr/soc/aspeed/Kconfig"
osource "/home/tverdyy/Projects/uroblike-zyraft/zephyr/soc/arm/Kconfig"
osource "/home/tverdyy/Projects/uroblike-zyraft/zephyr/soc/arm/beetle/Kconfig"
osource "/home/tverdyy/Projects/uroblike-zyraft/zephyr/soc/antmicro/myra/Kconfig"
osource "/home/tverdyy/Projects/uroblike-zyraft/zephyr/soc/andestech/Kconfig"
osource "/home/tverdyy/Projects/uroblike-zyraft/zephyr/soc/amd/acp_6_0/Kconfig"
osource "/home/tverdyy/Projects/uroblike-zyraft/zephyr/soc/ambiq/Kconfig"
osource "/home/tverdyy/Projects/uroblike-zyraft/zephyr/soc/altr/zephyr_nios2f/Kconfig"
osource "/home/tverdyy/Projects/uroblike-zyraft/zephyr/soc/altr/qemu_nios2/Kconfig"
osource "/home/tverdyy/Projects/uroblike-zyraft/zephyr/soc/adi/max32/Kconfig"
```

## build/zyraft_dongle/Kconfig/boards/Kconfig.sysbuild
```kconfig
# Load Sysbuild board Kconfig descriptions.
osource "/home/tverdyy/Projects/uroblike-zyraft/zephyr/boards/seeed/xiao_ble/Kconfig.sysbuild"
osource "/home/tverdyy/Projects/uroblike-zyraft/zmk/app/boards/seeed/xiao_ble/Kconfig.sysbuild"
```

## build/zyraft_dongle/Kconfig/boards/Kconfig.xiao_ble
```kconfig
# Load board Kconfig descriptions.
osource "/home/tverdyy/Projects/uroblike-zyraft/zephyr/boards/seeed/xiao_ble/Kconfig.xiao_ble"
osource "/home/tverdyy/Projects/uroblike-zyraft/zmk/app/boards/seeed/xiao_ble/Kconfig.xiao_ble"
```
