## build/zyraft_dongle_nostudio/Kconfig/Kconfig.modules
```kconfig
config ZEPHYR_ZYRAFT_CONFIG_MODULE
	bool
	default y
config ZEPHYR_ZMK_HELPERS_MODULE
	bool
	default y
menu "zmk-unicode (/home/tverdyy/Projects/uroblike-zyraft/zmk-unicode)"
osource "/home/tverdyy/Projects/uroblike-zyraft/zmk-unicode/Kconfig"
config ZEPHYR_ZMK_UNICODE_MODULE
	bool
	default y
endmenu
menu "zmk-auto-layer (/home/tverdyy/Projects/uroblike-zyraft/zmk-auto-layer)"
osource "/home/tverdyy/Projects/uroblike-zyraft/zmk-auto-layer/Kconfig"
config ZEPHYR_ZMK_AUTO_LAYER_MODULE
	bool
	default y
endmenu
menu "zmk-adaptive-key (/home/tverdyy/Projects/uroblike-zyraft/zmk-adaptive-key)"
osource "/home/tverdyy/Projects/uroblike-zyraft/zmk-adaptive-key/Kconfig"
config ZEPHYR_ZMK_ADAPTIVE_KEY_MODULE
	bool
	default y
endmenu
menu "zmk-leader-key (/home/tverdyy/Projects/uroblike-zyraft/zmk-leader-key)"
osource "/home/tverdyy/Projects/uroblike-zyraft/zmk-leader-key/Kconfig"
config ZEPHYR_ZMK_LEADER_KEY_MODULE
	bool
	default y
endmenu
menu "zmk-tri-state (/home/tverdyy/Projects/uroblike-zyraft/zmk-tri-state)"
osource "/home/tverdyy/Projects/uroblike-zyraft/zmk-tri-state/Kconfig"
config ZEPHYR_ZMK_TRI_STATE_MODULE
	bool
	default y
endmenu
menu "zmk-behavior-oskey (/home/tverdyy/Projects/uroblike-zyraft/oskey)"
osource "/home/tverdyy/Projects/uroblike-zyraft/oskey/Kconfig"
config ZEPHYR_ZMK_BEHAVIOR_OSKEY_MODULE
	bool
	default y
endmenu
config ZEPHYR_HAL_STM32_MODULE
	bool
	default y

config ZEPHYR_HAL_STM32_MODULE_BLOBS
	bool
menu "lvgl (/home/tverdyy/Projects/uroblike-zyraft/modules/lib/gui/lvgl)"
osource "/home/tverdyy/Projects/uroblike-zyraft/modules/lib/gui/lvgl/zephyr/Kconfig"
config ZEPHYR_LVGL_MODULE
	bool
	default y
endmenu
config ZEPHYR_ZMK_STUDIO_MESSAGES_MODULE
	bool
	default y
menu "canopennode (/home/tverdyy/Projects/uroblike-zyraft/modules/lib/canopennode)"
osource "$(ZEPHYR_CANOPENNODE_KCONFIG)"
config ZEPHYR_CANOPENNODE_MODULE
	bool
	default y
endmenu
menu "chre (/home/tverdyy/Projects/uroblike-zyraft/modules/lib/chre)"
osource "/home/tverdyy/Projects/uroblike-zyraft/modules/lib/chre/platform/zephyr/Kconfig"
config ZEPHYR_CHRE_MODULE
	bool
	default y
endmenu
menu "lz4 (/home/tverdyy/Projects/uroblike-zyraft/modules/lib/lz4)"
osource "$(ZEPHYR_LZ4_KCONFIG)"
config ZEPHYR_LZ4_MODULE
	bool
	default y
endmenu
menu "nanopb (/home/tverdyy/Projects/uroblike-zyraft/modules/lib/nanopb)"
osource "$(ZEPHYR_NANOPB_KCONFIG)"
config ZEPHYR_NANOPB_MODULE
	bool
	default y
endmenu
config ZEPHYR_PSA_ARCH_TESTS_MODULE
	bool
	default y
menu "sof (/home/tverdyy/Projects/uroblike-zyraft/modules/audio/sof)"
osource "/home/tverdyy/Projects/uroblike-zyraft/modules/audio/sof/zephyr/Kconfig"
config ZEPHYR_SOF_MODULE
	bool
	default y
endmenu
config ZEPHYR_TF_M_TESTS_MODULE
	bool
	default y
menu "tflite-micro (/home/tverdyy/Projects/uroblike-zyraft/optional/modules/lib/tflite-micro)"
osource "$(ZEPHYR_TFLITE_MICRO_KCONFIG)"
config ZEPHYR_TFLITE_MICRO_MODULE
	bool
	default y
endmenu
menu "thrift (/home/tverdyy/Projects/uroblike-zyraft/optional/modules/lib/thrift)"
osource "$(ZEPHYR_THRIFT_KCONFIG)"
config ZEPHYR_THRIFT_MODULE
	bool
	default y
endmenu
menu "lang-rust (/home/tverdyy/Projects/uroblike-zyraft/modules/lang/rust)"
osource "/home/tverdyy/Projects/uroblike-zyraft/modules/lang/rust/Kconfig"
config ZEPHYR_LANG_RUST_MODULE
	bool
	default y
endmenu
menu "zscilib (/home/tverdyy/Projects/uroblike-zyraft/modules/lib/zscilib)"
osource "/home/tverdyy/Projects/uroblike-zyraft/modules/lib/zscilib/Kconfig.zscilib"
config ZEPHYR_ZSCILIB_MODULE
	bool
	default y
endmenu
menu "acpica (/home/tverdyy/Projects/uroblike-zyraft/modules/lib/acpica)"
osource "$(ZEPHYR_ACPICA_KCONFIG)"
config ZEPHYR_ACPICA_MODULE
	bool
	default y
endmenu
menu "cmsis (/home/tverdyy/Projects/uroblike-zyraft/modules/hal/cmsis)"
osource "$(ZEPHYR_CMSIS_KCONFIG)"
config ZEPHYR_CMSIS_MODULE
	bool
	default y
endmenu
menu "cmsis-dsp (/home/tverdyy/Projects/uroblike-zyraft/modules/lib/cmsis-dsp)"
osource "$(ZEPHYR_CMSIS_DSP_KCONFIG)"
config ZEPHYR_CMSIS_DSP_MODULE
	bool
	default y
endmenu
menu "cmsis-nn (/home/tverdyy/Projects/uroblike-zyraft/modules/lib/cmsis-nn)"
osource "$(ZEPHYR_CMSIS_NN_KCONFIG)"
config ZEPHYR_CMSIS_NN_MODULE
	bool
	default y
endmenu
menu "fatfs (/home/tverdyy/Projects/uroblike-zyraft/modules/fs/fatfs)"
osource "$(ZEPHYR_FATFS_KCONFIG)"
config ZEPHYR_FATFS_MODULE
	bool
	default y
endmenu
config ZEPHYR_ADI_MODULE
	bool
	default y
menu "hal_ambiq (/home/tverdyy/Projects/uroblike-zyraft/modules/hal/ambiq)"
osource "$(ZEPHYR_HAL_AMBIQ_KCONFIG)"
config ZEPHYR_HAL_AMBIQ_MODULE
	bool
	default y
endmenu
config ZEPHYR_ATMEL_MODULE
	bool
	default y
menu "hal_espressif (/home/tverdyy/Projects/uroblike-zyraft/modules/hal/espressif)"
osource "/home/tverdyy/Projects/uroblike-zyraft/modules/hal/espressif/zephyr/Kconfig"
config ZEPHYR_HAL_ESPRESSIF_MODULE
	bool
	default y

config ZEPHYR_HAL_ESPRESSIF_MODULE_BLOBS
	bool
endmenu
menu "hal_ethos_u (/home/tverdyy/Projects/uroblike-zyraft/modules/hal/ethos_u)"
osource "$(ZEPHYR_HAL_ETHOS_U_KCONFIG)"
config ZEPHYR_HAL_ETHOS_U_MODULE
	bool
	default y
endmenu
menu "hal_gigadevice (/home/tverdyy/Projects/uroblike-zyraft/modules/hal/gigadevice)"
osource "$(ZEPHYR_HAL_GIGADEVICE_KCONFIG)"
config ZEPHYR_HAL_GIGADEVICE_MODULE
	bool
	default y
endmenu
menu "hal_intel (/home/tverdyy/Projects/uroblike-zyraft/modules/hal/intel)"
osource "/home/tverdyy/Projects/uroblike-zyraft/modules/hal/intel/zephyr/Kconfig"
config ZEPHYR_HAL_INTEL_MODULE
	bool
	default y
endmenu
menu "hal_nordic (/home/tverdyy/Projects/uroblike-zyraft/modules/hal/nordic)"
osource "$(ZEPHYR_HAL_NORDIC_KCONFIG)"
config ZEPHYR_HAL_NORDIC_MODULE
	bool
	default y

config ZEPHYR_HAL_NORDIC_MODULE_BLOBS
	bool
endmenu
config ZEPHYR_NUVOTON_MODULE
	bool
	default y
config ZEPHYR_QUICKLOGIC_MODULE
	bool
	default y
config ZEPHYR_HAL_RENESAS_MODULE
	bool
	default y

config ZEPHYR_HAL_RENESAS_MODULE_BLOBS
	bool
menu "hal_rpi_pico (/home/tverdyy/Projects/uroblike-zyraft/modules/hal/rpi_pico)"
osource "$(ZEPHYR_HAL_RPI_PICO_KCONFIG)"
config ZEPHYR_HAL_RPI_PICO_MODULE
	bool
	default y
endmenu
menu "hal_silabs (/home/tverdyy/Projects/uroblike-zyraft/modules/hal/silabs)"
osource "$(ZEPHYR_HAL_SILABS_KCONFIG)"
config ZEPHYR_HAL_SILABS_MODULE
	bool
	default y

config ZEPHYR_HAL_SILABS_MODULE_BLOBS
	bool
endmenu
menu "hal_tdk (/home/tverdyy/Projects/uroblike-zyraft/modules/hal/tdk)"
osource "$(ZEPHYR_HAL_TDK_KCONFIG)"
config ZEPHYR_HAL_TDK_MODULE
	bool
	default y
endmenu
menu "hal_telink (/home/tverdyy/Projects/uroblike-zyraft/modules/hal/telink)"
osource "/home/tverdyy/Projects/uroblike-zyraft/modules/hal/telink/Kconfig"
config ZEPHYR_HAL_TELINK_MODULE
	bool
	default y
endmenu
menu "hal_wch (/home/tverdyy/Projects/uroblike-zyraft/modules/hal/wch)"
osource "$(ZEPHYR_HAL_WCH_KCONFIG)"
config ZEPHYR_HAL_WCH_MODULE
	bool
	default y
endmenu
config ZEPHYR_HAL_WURTHELEKTRONIK_MODULE
	bool
	default y
menu "hostap (/home/tverdyy/Projects/uroblike-zyraft/modules/lib/hostap)"
osource "$(ZEPHYR_HOSTAP_KCONFIG)"
config ZEPHYR_HOSTAP_MODULE
	bool
	default y
endmenu
menu "liblc3 (/home/tverdyy/Projects/uroblike-zyraft/modules/lib/liblc3)"
osource "$(ZEPHYR_LIBLC3_KCONFIG)"
config ZEPHYR_LIBLC3_MODULE
	bool
	default y
endmenu
config ZEPHYR_LIBMCTP_MODULE
	bool
	default y
config ZEPHYR_LIBMETAL_MODULE
	bool
	default y
menu "littlefs (/home/tverdyy/Projects/uroblike-zyraft/modules/fs/littlefs)"
osource "$(ZEPHYR_LITTLEFS_KCONFIG)"
config ZEPHYR_LITTLEFS_MODULE
	bool
	default y
endmenu
menu "mbedtls (/home/tverdyy/Projects/uroblike-zyraft/modules/crypto/mbedtls)"
osource "$(ZEPHYR_MBEDTLS_KCONFIG)"
config ZEPHYR_MBEDTLS_MODULE
	bool
	default y
endmenu
config ZEPHYR_MIPI_SYS_T_MODULE
	bool
	default y
menu "nrf_wifi (/home/tverdyy/Projects/uroblike-zyraft/modules/lib/nrf_wifi)"
osource "$(ZEPHYR_NRF_WIFI_KCONFIG)"
config ZEPHYR_NRF_WIFI_MODULE
	bool
	default y

config ZEPHYR_NRF_WIFI_MODULE_BLOBS
	bool
endmenu
config ZEPHYR_OPEN_AMP_MODULE
	bool
	default y
menu "percepio (/home/tverdyy/Projects/uroblike-zyraft/modules/debug/percepio)"
osource "/home/tverdyy/Projects/uroblike-zyraft/modules/debug/percepio/zephyr/Kconfig"
config ZEPHYR_PERCEPIO_MODULE
	bool
	default y
endmenu
menu "picolibc (/home/tverdyy/Projects/uroblike-zyraft/modules/lib/picolibc)"
osource "/home/tverdyy/Projects/uroblike-zyraft/modules/lib/picolibc/zephyr/Kconfig"
config ZEPHYR_PICOLIBC_MODULE
	bool
	default y
endmenu
menu "segger (/home/tverdyy/Projects/uroblike-zyraft/modules/debug/segger)"
osource "$(ZEPHYR_SEGGER_KCONFIG)"
config ZEPHYR_SEGGER_MODULE
	bool
	default y
endmenu
config ZEPHYR_TINYCRYPT_MODULE
	bool
	default y
menu "trusted-firmware-a (/home/tverdyy/Projects/uroblike-zyraft/modules/tee/tf-a/trusted-firmware-a)"
osource "$(ZEPHYR_TRUSTED_FIRMWARE_A_KCONFIG)"
config ZEPHYR_TRUSTED_FIRMWARE_A_MODULE
	bool
	default y
endmenu
menu "uoscore-uedhoc (/home/tverdyy/Projects/uroblike-zyraft/modules/lib/uoscore-uedhoc)"
osource "$(ZEPHYR_UOSCORE_UEDHOC_KCONFIG)"
config ZEPHYR_UOSCORE_UEDHOC_MODULE
	bool
	default y
endmenu
menu "zcbor (/home/tverdyy/Projects/uroblike-zyraft/modules/lib/zcbor)"
osource "$(ZEPHYR_ZCBOR_KCONFIG)"
config ZEPHYR_ZCBOR_MODULE
	bool
	default y
endmenu
menu "module (/home/tverdyy/Projects/uroblike-zyraft/zmk/app/module)"
osource "/home/tverdyy/Projects/uroblike-zyraft/zmk/app/module/Kconfig"
config ZEPHYR_MODULE_MODULE
	bool
	default y
endmenu
config ZEPHYR_KEYMAP_MODULE_MODULE
	bool
	default y
menu "prospector-zmk-module (/home/tverdyy/Projects/uroblike-zyraft/prospector-zmk-module)"
osource "/home/tverdyy/Projects/uroblike-zyraft/prospector-zmk-module/Kconfig"
config ZEPHYR_PROSPECTOR_ZMK_MODULE_MODULE
	bool
	default y
endmenu
config ZEPHYR_NRF_HW_MODELS_MODULE
	bool
	default y
```

## build/zyraft_dongle_nostudio/Kconfig/arch/Kconfig
```kconfig
# Load Zephyr Arch Kconfig descriptions.
osource "/home/tverdyy/Projects/uroblike-zyraft/zephyr/arch/x86/Kconfig"
osource "/home/tverdyy/Projects/uroblike-zyraft/zephyr/arch/xtensa/Kconfig"
osource "/home/tverdyy/Projects/uroblike-zyraft/zephyr/arch/sparc/Kconfig"
osource "/home/tverdyy/Projects/uroblike-zyraft/zephyr/arch/riscv/Kconfig"
osource "/home/tverdyy/Projects/uroblike-zyraft/zephyr/arch/posix/Kconfig"
osource "/home/tverdyy/Projects/uroblike-zyraft/zephyr/arch/nios2/Kconfig"
osource "/home/tverdyy/Projects/uroblike-zyraft/zephyr/arch/mips/Kconfig"
osource "/home/tverdyy/Projects/uroblike-zyraft/zephyr/arch/arm64/Kconfig"
osource "/home/tverdyy/Projects/uroblike-zyraft/zephyr/arch/arm/Kconfig"
osource "/home/tverdyy/Projects/uroblike-zyraft/zephyr/arch/arc/Kconfig"
```

## build/zyraft_dongle_nostudio/Kconfig/boards/Kconfig
```kconfig
# Load Zephyr board Kconfig descriptions.
osource "/home/tverdyy/Projects/uroblike-zyraft/zephyr/boards/seeed/xiao_ble/Kconfig"
osource "/home/tverdyy/Projects/uroblike-zyraft/zmk/app/boards/seeed/xiao_ble/Kconfig"
```

## build/zyraft_dongle_nostudio/Kconfig/boards/Kconfig.defconfig
```kconfig
# Load Zephyr board defconfig descriptions.
osource "/home/tverdyy/Projects/uroblike-zyraft/zephyr/boards/seeed/xiao_ble/Kconfig.defconfig"
osource "/home/tverdyy/Projects/uroblike-zyraft/zmk/app/boards/seeed/xiao_ble/Kconfig.defconfig"
```

## build/zyraft_left/Kconfig/Kconfig.shield
```kconfig
osource "/home/tverdyy/Projects/uroblike-zyraft/config/boards/shields/*/Kconfig.shield"
osource "/home/tverdyy/Projects/uroblike-zyraft/zmk/app/module/boards/shields/*/Kconfig.shield"
osource "/home/tverdyy/Projects/uroblike-zyraft/prospector-zmk-module/boards/shields/*/Kconfig.shield"
osource "/home/tverdyy/Projects/uroblike-zyraft/zmk/app/boards/shields/*/Kconfig.shield"
osource "/home/tverdyy/Projects/uroblike-zyraft/config/boards/shields/*/Kconfig.shield"
```

## build/zyraft_left/Kconfig/boards/Kconfig.nice_nano
```kconfig
# Load board Kconfig descriptions.
osource "/home/tverdyy/Projects/uroblike-zyraft/zmk/app/module/boards/nicekeyboards/nice_nano/Kconfig.nice_nano"
osource "/home/tverdyy/Projects/uroblike-zyraft/zmk/app/boards/nicekeyboards/nice_nano/Kconfig.nice_nano"
```

## build/zyraft_left/Kconfig/boards/Kconfig.sysbuild
```kconfig
# Load Sysbuild board Kconfig descriptions.
osource "/home/tverdyy/Projects/uroblike-zyraft/zmk/app/module/boards/nicekeyboards/nice_nano/Kconfig.sysbuild"
osource "/home/tverdyy/Projects/uroblike-zyraft/zmk/app/boards/nicekeyboards/nice_nano/Kconfig.sysbuild"
```

## config/west.yml
```yaml
manifest:
  remotes:
    - name: zmkfirmware
      url-base: https://github.com/zmkfirmware
    - name: urob
      url-base: https://github.com/urob
    - name: carrefinho
      url-base: https://github.com/carrefinho
    - name: dhruvinsh
      url-base: https://github.com/dhruvinsh
  projects:
    - name: zmk
      remote: zmkfirmware
      revision: main
      import: app/west.yml
    - name: zmk-helpers
      remote: urob
      revision: main
    - name: zmk-unicode
      remote: urob
      revision: main
    - name: zmk-auto-layer
      remote: urob
      revision: main
    - name: zmk-adaptive-key
      remote: urob
      revision: main
    - name: zmk-leader-key
      remote: urob
      revision: main
    - name: zmk-tri-state
      remote: dhruvinsh
      revision: main
    - name: prospector-zmk-module
      remote: carrefinho
      revision: feat/new-status-screens
  self:
    path: config
```
