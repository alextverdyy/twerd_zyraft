/* Home-row modifiers */

MAKE_HRM(hml, &kp, &kp, KEYS_R THUMBS)
MAKE_HRM(hmr, &kp, &kp, KEYS_L THUMBS)

/* Navigation tap/hold keys */

#define MT_CORE \
    flavor = "tap-preferred"; \
    tapping-term-ms = <220>; \
    quick-tap-ms = <220>; \
    hold-trigger-key-positions = <0>;

&mt { MT_CORE };

ZMK_HOLD_TAP(mt_home, bindings = <&masked_home>, <&kp>; MT_CORE)
ZMK_HOLD_TAP(mt_end, bindings = <&masked_end>, <&kp>; MT_CORE)

#define NAV_LEFT  &mt_home 0 LEFT
#define NAV_RIGHT &mt_end 0 RIGHT
#define NAV_UP    &mt LC(HOME) UP
#define NAV_DOWN  &mt LC(END) DOWN
#define NAV_BSPC  &mt LC(BSPC) BSPC
#define NAV_DEL   &mt LC(DEL) DEL

#define MASK_MODS(NAME, MODS, BINDING) \
    ZMK_MOD_MORPH(NAME, bindings = <BINDING>, <BINDING>; mods = <MODS>;)

// Mask Ctrl on left/right hold to avoid accidental document jumps.
MASK_MODS(masked_home, (MOD_LCTL), &kp HOME)
MASK_MODS(masked_end, (MOD_LCTL), &kp END)

/* Magic Shift and automatic layers */

// Tap: repeat after an alpha, otherwise sticky Shift.
// Shift + tap: Caps Word. Hold: Shift.
#define MAGIC_SHIFT &magic_shift LSHFT 0
ZMK_HOLD_TAP(magic_shift, bindings = <&kp>, <&magic_shift_tap>;
    flavor = "balanced";
    tapping-term-ms = <200>;
    quick-tap-ms = <QUICK_TAP_MS>;
    hold-trigger-key-positions = <THUMBS>;)

ZMK_MOD_MORPH(magic_shift_tap, bindings = <&shift_repeat>, <&caps_word>;
    mods = <(MOD_LSFT)>;)

ZMK_ADAPTIVE_KEY(
    shift_repeat, bindings = <&sk LSHFT>;
    repeat {
        trigger-keys = <A B C D E F G H I J K L M N O P Q R S T U V W X Y Z>;
        bindings = <&key_repeat>;
        max-prior-idle-ms = <1200>;
        strict-modifiers;
    };
)

&caps_word {
    /delete-property/ ignore-modifiers;
};

// Tap: number word. Double-tap: sticky NUM.
ZMK_TAP_DANCE(num_dance, bindings = <&num_word NUM>, <&sl NUM>;
    tapping-term-ms = <200>;)

ZMK_TRI_STATE(
    smart_mouse, bindings = <&tog MOUSE>, <&none>, <&tog MOUSE>;
    ignored-key-positions = <LT1 LT2>;
    ignored-layers = <MOUSE NAV FN>;
)

/* Punctuation */

#define SIMPLE_MORPH(NAME, MOD, BINDING1, BINDING2) \
    ZMK_MOD_MORPH(NAME, mods = <(MOD_L##MOD | MOD_R##MOD)>; \
    bindings = <BINDING1>, <BINDING2>;)

SIMPLE_MORPH(comma_morph, SFT, &kp COMMA, &comma_inner_morph)
SIMPLE_MORPH(comma_inner_morph, CTL, &kp SEMICOLON, &kp LESS_THAN)
SIMPLE_MORPH(dot_morph, SFT, &kp DOT, &dot_inner_morph)
SIMPLE_MORPH(dot_inner_morph, CTL, &kp COLON, &kp GREATER_THAN)
SIMPLE_MORPH(qexcl, SFT, &kp QMARK, &kp EXCL)
SIMPLE_MORPH(lpar_lt, SFT, &kp LPAR, &kp LT)
SIMPLE_MORPH(rpar_gt, SFT, &kp RPAR, &kp GT)

/* Thumb keys */

// Tap: Space | double-tap: Escape | hold: NAV.
ZMK_HOLD_TAP(lt_spc, bindings = <&mo>, <&spc_dance>;
    flavor = "balanced";
    tapping-term-ms = <200>;
    quick-tap-ms = <QUICK_TAP_MS>;)
ZMK_TAP_DANCE(spc_dance, bindings = <&kp SPACE>, <&kp ESC>;
    tapping-term-ms = <200>;)

// Tap: Return | double-tap: Tab | hold: layer passed as param1 (SYM on Zyraft).
ZMK_HOLD_TAP(lt_ret, bindings = <&mo>, <&rt_dance>;
    flavor = "balanced";
    tapping-term-ms = <200>;
    quick-tap-ms = <QUICK_TAP_MS>;)
ZMK_TAP_DANCE(rt_dance, bindings = <&kp RET>, <&kp TAB>;
    tapping-term-ms = <200>;)

// Tap: Backspace | Shift + tap: Escape | hold: NUM.
ZMK_MOD_MORPH(bs_esc, mods = <(MOD_LSFT | MOD_RSFT)>;
    bindings = <&kp BSPC>, <&kp ESC>;)
ZMK_HOLD_TAP(rh1_smart, bindings = <&mo>, <&bs_esc>;
    flavor = "balanced";
    tapping-term-ms = <200>;
    quick-tap-ms = <QUICK_TAP_MS>;)

// Tap: sticky SYM | hold: SYM.
ZMK_HOLD_TAP(magic_sym, bindings = <&mo>, <&sl>;
    flavor = "balanced";
    tapping-term-ms = <200>;
    quick-tap-ms = <QUICK_TAP_MS>;)

// Sticky Shift followed by the leader key.
ZMK_MACRO(leader_sft, bindings = <&sk LSHFT &leader>;)

/* Aliases */

#define CANCEL   &kp K_CANCEL
#define DSK_PREV &hmr LCTRL LG(LC(LEFT))
#define DSK_NEXT &hmr LALT LG(LC(RIGHT))
#define PIN_WIN  &kp LG(LC(LS(Q)))
#define PIN_APP  &kp LG(LC(LS(A)))
#define DSK_MGR  &kp LA(GRAVE)
#define VOL_DOWN &hmr RSHFT C_VOL_DN
