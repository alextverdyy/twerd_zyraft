#define CONFIG_WIRELESS

#include <zmk-helpers/key-labels/34.h>

// 34.h declares THUMBS as LH0 LH1 RH0 RH1. The physical order here is
// LH1 LH0 RH0 RH1, matching the Zyraft matrix transform.
#undef THUMBS
#define THUMBS LH1 LH0 RH0 RH1

#include "keymap/definitions.dtsi"
#include "keymap/behaviors.dtsi"
#include "keymap/os.dtsi"
#include "keymap/leader.dtsi"
#include "keymap/mouse.dtsi"
#include "keymap/combos.dtsi"

/* Layers */

ZYRAFT_LAYER(Base,
    /* left top */     &kp Q &kp W &kp E &kp R &kp T,
    /* right top */    &kp Y &kp U &kp I &kp O &kp P,
    /* left home */    &hml LCTRL A &hml LALT S &hml LGUI D &hml LSHFT F &kp G,
    /* right home */   &kp H &hmr RSHFT J &hmr LGUI K &hmr RALT L &hmr RCTRL SEMI,
    /* left bottom */  &kp Z &kp X &kp C &kp V &kp B,
    /* right bottom */ &kp N &kp M &comma_morph &dot_morph &qexcl,
    /* left thumbs */  MAGIC_SHIFT &lt_spc NAV 0,
    /* right thumbs */ &lt_ret SYM 0 &rh1_smart NUM 0
)

ZYRAFT_LAYER(Nav,
    /* left top */     &kp LA(F4) ___ &kp LS(TAB) &swapper ___,
    /* right top */    &kp PG_UP NAV_BSPC NAV_UP NAV_DEL ___,
    /* left home */    &sk LGUI &sk LALT &sk LSHFT &sk LCTRL ___,
    /* right home */   &kp PG_DN NAV_LEFT NAV_DOWN NAV_RIGHT &kp RET,
    /* left bottom */  &ok_undo &ok_redo ___ ___ ___,
    /* right bottom */ &kp INS &kp TAB ___ ___ ___,
    /* left thumbs */  ___ ___,
    /* right thumbs */ &tog FN &kp LC(S)
)

ZYRAFT_LAYER(Fn,
    /* left top */     &kp F12 &kp F7 &kp F8 &kp F9 ___,
    /* right top */    ___ &kp C_PREV &kp C_VOL_UP &kp C_NEXT ___,
    /* left home */    &hml LGUI F11 &hml LALT F4 &hml LSHFT F5 &hml LCTRL F6 ___,
    /* right home */   ___ DSK_PREV VOL_DOWN DSK_NEXT ___,
    /* left bottom */  &kp F10 &kp F1 &kp F2 &kp F3 ___,
    /* right bottom */ PIN_APP PIN_WIN DSK_MGR ___ &tog SYS,
    /* left thumbs */  &to DEF &to DEF,
    /* right thumbs */ &kp C_MUTE &kp C_PP
)

ZYRAFT_LAYER(Num,
    /* left top */     ___ &kp N7 &kp N8 &kp N9 ___,
    /* right top */    ___ ___ ___ ___ ___,
    /* left home */    &hml LGUI N0 &hml LALT N4 &hml LSHFT N5 &hml LCTRL N6 ___,
    /* right home */   ___ ___ ___ ___ ___,
    /* left bottom */  ___ &kp N1 &kp N2 &kp N3 ___,
    /* right bottom */ ___ ___ ___ ___ ___,
    /* left thumbs */  ___ ___,
    /* right thumbs */ ___ ___
)

ZYRAFT_LAYER(Sys,
    /* left top */     &os_sel OS_WIN &os_sel OS_MAC &os_sel OS_LIN ___ ___,
    /* right top */    &out OUT_USB &out OUT_BLE ___ ___ ___,
    /* left home */    &bt BT_SEL 0 &bt BT_SEL 1 &bt BT_SEL 2 &bt BT_SEL 3 &bt BT_CLR,
    /* right home */   &bootloader ___ ___ ___ ___,
    /* left bottom */  &studio_unlock ___ ___ ___ &sys_reset,
    /* right bottom */ &sys_reset ___ ___ ___ ___,
    /* left thumbs */  &to DEF &to DEF,
    /* right thumbs */ &to DEF &to DEF
)

ZYRAFT_LAYER(Mouse,
    /* left top */     &mkp MB4 &mkp MB5 &mkp MCLK &mkp LCLK &mkp RCLK,
    /* right top */    ___ &kp PG_UP U_MS_U &kp PG_DN ___,
    /* left home */    U_WH_L U_WH_D U_WH_U U_WH_R ___,
    /* right home */   U_WH_L U_MS_L U_MS_D U_MS_R U_WH_R,
    /* left bottom */  &mkp MB1 &mkp MB2 &mkp MB3 ___ &mkp MCLK,
    /* right bottom */ ___ &mkp LCLK &mkp MCLK &mkp RCLK ___,
    /* left thumbs */  ___ ___,
    /* right thumbs */ U_WH_U U_WH_D
)

ZYRAFT_LAYER(Sym,
    /* left top */     &kp LBRC &kp AMPS &kp STAR &kp LPAR &kp RBRC,
    /* right top */    &kp N6 &kp N7 &kp N8 &kp N9 &kp N0,
    /* left home */    &kp SQT &kp DLLR &kp PERCENT &kp CARET &kp PLUS,
    /* right home */   &kp DQT &kp QMARK &kp SQT &kp MINUS &kp ASTRK,
    /* left bottom */  ___ &kp TILDE &kp EXCL &kp AT &kp HASH,
    /* right bottom */ &kp PIPE &kp UNDER &kp EXCL &kp DQT &kp PLUS,
    /* left thumbs */  ___ &kp LPAR,
    /* right thumbs */ &kp RBRC &kp FSLH
)

/* vim: set ft=c tw=120: */
