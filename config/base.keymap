#include <behaviors.dtsi>
#include <behaviors/num_word.dtsi> // Requires zmk-auto-layer module.
#include <behaviors/unicode.dtsi> // Requires zmk-unicode module.
#include <zmk-helpers/helper.h> // Requires zmk-helpers module.
#include <dt-bindings/zmk/keys.h>

#ifdef CONFIG_WIRELESS
#include <dt-bindings/zmk/bt.h>
#include <dt-bindings/zmk/outputs.h>
#define _BT_SEL_KEYS_ \
    &bt BT_SEL 0 &bt BT_SEL 1 &bt BT_SEL 2 &bt BT_SEL 3 &bt BT_CLR
#else
#define _BT_SEL_KEYS_ &trans &trans &trans &trans &trans
#endif

#define DEF 0
#define NAV 1
#define FN 2
#define NUM 3
#define SYS 4
#define MOUSE 5
#define SYM 6

#define XXX &none
#define ___ &trans

/* Global defaults */
#define QUICK_TAP_MS 175

&sk {
    release-after-ms = <900>;
    quick-release;
};

&sl { // Allow sticky mods to chord across sticky layers.
    ignore-modifiers;
};

&lt {
    flavor = "balanced";
    tapping-term-ms = <200>;
    quick-tap-ms = <QUICK_TAP_MS>;
};

/* Homerow mods */
#define MAKE_HRM(NAME, HOLD, TAP, TRIGGER_POS) \
    ZMK_HOLD_TAP(NAME, bindings = <HOLD>, <TAP>; flavor = "balanced"; \
    tapping-term-ms = <280>; quick-tap-ms = <QUICK_TAP_MS>; \
    require-prior-idle-ms = <150>; hold-trigger-on-release; \
    hold-trigger-key-positions = <TRIGGER_POS>;)

MAKE_HRM(hml, &kp, &kp, KEYS_R THUMBS) // Left-hand HRMs.
MAKE_HRM(hmr, &kp, &kp, KEYS_L THUMBS) // Right-hand HRMs.

// Hack: Make HRM combo tap-only (cf, ZMK issue #544).
#define ZMK_COMBO_8(NAME, TAP, POS, LAYERS, COMBO_MS, IDLE_MS, HOLD, SIDE) \
    MAKE_HRM(hm_combo_##NAME, &kp, TAP, SIDE THUMBS) \
    ZMK_COMBO_6(NAME, &hm_combo_##NAME HOLD 0, POS, LAYERS, COMBO_MS, IDLE_MS)

/* Combos, leader key sequences, mouse emulation */
#include "combos.dtsi" // Must be sourced after HRM-combo hack.
#include "leader.dtsi"
#include "mouse.dtsi"

/* Nav cluster */
// Trigger tap-action on all interrupts.
#define MT_CORE \
    flavor = "tap-preferred"; \
    tapping-term-ms = <220>; \
    quick-tap-ms = <220>; \
    hold-trigger-key-positions = <0>;

&mt { MT_CORE };

ZMK_HOLD_TAP(mt_home, bindings = <&masked_home>, <&kp>; MT_CORE)
ZMK_HOLD_TAP(mt_end, bindings = <&masked_end>, <&kp>; MT_CORE)

#define NAV_LEFT  &mt_home 0 LEFT   // Tap: left | Long-tap: start of line.
#define NAV_RIGHT &mt_end 0 RIGHT   // Tap: right | Long-tap: end of line.
#define NAV_UP    &mt LC(HOME) UP   // Tap: up | Long-tap: start of doc.
#define NAV_DOWN  &mt LC(END) DOWN  // Tap: down | Long-tap: end of doc.
#define NAV_BSPC  &mt LC(BSPC) BSPC // Tap: bspc | Long-tap: delete word bwd.
#define NAV_DEL   &mt LC(DEL) DEL   // Tap: del | Long-tap: delete word fwd.

// Mask CTRL on left/right hold to avoid accidental jumps to start/end of doc.
#define MASK_MODS(NAME, MODS, BINDING) \
    ZMK_MOD_MORPH(NAME, bindings = <BINDING>, <BINDING>; mods = <MODS>;)

MASK_MODS(masked_home, (MOD_LCTL), &kp HOME)
MASK_MODS(masked_end, (MOD_LCTL), &kp END)

/* Magic-shift & auto-layers */
// Tap: repeat after alpha, else sticky-shift |
// Shift + tap/ double-tap: caps-word | Hold: shift.
#define MAGIC_SHIFT &magic_shift LSHFT 0
ZMK_HOLD_TAP(magic_shift, bindings = <&kp>, <&magic_shift_tap>;
    flavor = "balanced"; tapping-term-ms = <200>;
    quick-tap-ms = <QUICK_TAP_MS>;
    hold-trigger-key-positions = <THUMBS>;)

/* rh0_smart: mod-morph on RH0. */
// Tap = RET.  With shift held (LH1 sticky or otherwise) = TAB.
// Used for the smart-shift chord pattern.
ZMK_MOD_MORPH(rh0_smart, mods = <(MOD_LSFT|MOD_RSFT)>;
              bindings = <&kp RET>, <&kp RET>;)

/* rh1_smart: mod-morph on RH1. */
// Tap = BSPC.  With shift held = ESC.
ZMK_MOD_MORPH(bs_esc, mods = <(MOD_LSFT|MOD_RSFT)>;
              bindings = <&kp BSPC>, <&kp ESC>;)

ZMK_HOLD_TAP(rh1_smart,
    bindings = <&mo>, <&bs_esc>;
    flavor = "balanced";
    tapping-term-ms = <200>;
    quick-tap-ms = <QUICK_TAP_MS>;
)

/* tmux_prefix: smart-toggle for tmux. */
// Tap = Ctrl+S (held as modifier). Next keypress = tmux command.
// Auto-release after one key.  Requires zmk-smart-toggle module.
#include "smart-toggle.dtsi"

ZMK_MOD_MORPH(magic_shift_tap, bindings = <&shift_repeat>, <&caps_word>;
    mods = <(MOD_LSFT)>;)

ZMK_ADAPTIVE_KEY(
    shift_repeat, bindings = <&sk LSHFT>;
    repeat {
        trigger-keys = <A B C D E F G H I J K L M N O P Q R S T U V W X Y Z>;
        bindings = <&key_repeat>;
        max-prior-idle-ms = <1200>;
        strict-modifiers;
    };
)

&caps_word { // Mods deactivate caps-word, requires PR #1451.
    /delete-property/ ignore-modifiers;
};

// Tap: num-word | double-tap: sticky num-layer | Hold: num-layer.
#define SMART_NUM &smart_num NUM 0
ZMK_HOLD_TAP(smart_num, bindings = <&mo>, <&num_dance>; flavor = "balanced";
    tapping-term-ms = <200>; quick-tap-ms = <QUICK_TAP_MS>;)

ZMK_TAP_DANCE(num_dance, bindings = <&num_word NUM>, <&sl NUM>;
    tapping-term-ms = <200>;)

// Smart-mouse, requires tri-state module.
ZMK_TRI_STATE(
    smart_mouse, bindings = <&tog MOUSE>, <&none>, <&tog MOUSE>;
    ignored-key-positions =
        <LT1 LT2>;
    ignored-layers = <MOUSE NAV FN>;
)

/* Custom behaviors */

// Define mod-morph with a *single* mod trigger for less repetition.
#define SIMPLE_MORPH(NAME, MOD, BINDING1, BINDING2) \
    ZMK_MOD_MORPH(NAME, mods = <(MOD_L##MOD | MOD_R##MOD)>; \
    bindings = <BINDING1>, <BINDING2>;)

// Tap: comma | Shift + tap: semicolon | Ctrl + shift + tap: <.
SIMPLE_MORPH(comma_morph, SFT, &kp COMMA, &comma_inner_morph)
SIMPLE_MORPH(comma_inner_morph, CTL, &kp SEMICOLON, &kp LESS_THAN)

// Tap: dot | Shift + tap: colon | Ctrl + shift + tap: >.
SIMPLE_MORPH(dot_morph, SFT, &kp DOT, &dot_inner_morph)
SIMPLE_MORPH(dot_inner_morph, CTL, &kp COLON, &kp GREATER_THAN)

// Tap: qmark | Shift + tap: excl.
SIMPLE_MORPH(qexcl, SFT, &kp QMARK, &kp EXCL)

// Tap: left/right parenthesis | Shft + tap: less-than/greater-than.
SIMPLE_MORPH(lpar_lt, SFT, &kp LPAR, &kp LT)
SIMPLE_MORPH(rpar_gt, SFT, &kp RPAR, &kp GT)

// Tap: space | double-tap: esc | Hold: nav layer.
ZMK_HOLD_TAP(lt_spc, bindings = <&mo>, <&spc_dance>; flavor = "balanced";
    tapping-term-ms = <200>; quick-tap-ms = <QUICK_TAP_MS>;)

ZMK_TAP_DANCE(spc_dance, bindings = <&kp SPACE>, <&kp ESC>;
    tapping-term-ms = <200>;)


// Tap: return | double-tap: tab | Hold: nav layer.
ZMK_HOLD_TAP(lt_ret, bindings = <&mo>, <&rt_dance>; flavor = "balanced";
    tapping-term-ms = <200>; quick-tap-ms = <QUICK_TAP_MS>;)

ZMK_TAP_DANCE(rt_dance, bindings = <&kp RET>, <&kp TAB>;
    tapping-term-ms = <200>;)

// Tap: backspace | Lshft + tap: delete | Rshft + tap: shift-delete.
ZMK_MOD_MORPH(bs_del, bindings = <&kp BSPC>, <&kp DEL>;
    mods = <(MOD_LSFT|MOD_RSFT)>; keep-mods = <MOD_RSFT>;)

// Tap: copy | double-tap: cut.
ZMK_TAP_DANCE(copy_cut, bindings = <&kp LC(INS)>, <&kp LC(X)>;
    tapping-term-ms = <200>;)

// Sticky shift + leader.
ZMK_MACRO(leader_sft, bindings = <&sk LSHFT &leader>;)

/* Misc aliases */
#define CANCEL &kp K_CANCEL // Cancel caps-word & auto-layers.
#define DSK_PREV &hmr LCTRL LG(LC(LEFT))  // Previous desktop.
#define DSK_NEXT &hmr LALT LG(LC(RIGHT)) // Next desktop.
#define PIN_WIN  &kp LG(LC(LS(Q)))         // Pin window across desktops.
#define PIN_APP  &kp LG(LC(LS(A)))         // Pin application across desktops.
#define DSK_MGR  &kp LA(GRAVE)             // Desktop manager.
#define VOL_DOWN &hmr RSHFT C_VOL_DN
#define RH1_SMART &rh1_smart NUM 0
#define RH0_SMART &lt_ret SYM 0

/* Keymap */
// ZMK_CONDITIONAL_LAYER(sys, FN NUM, SYS) // FN + NUM --> SYS.

#ifndef ZMK_BASE_LAYER
#define ZMK_BASE_LAYER(name, LT, RT, LM, RM, LB, RB, LH, RH) \
    ZMK_LAYER(name, LT RT LM RM LB RB LH RH)
#endif
